## CMakeLists.txt
```
# Copyright (c) 2026 Mateusz Żerebecki
# SPDX-License-Identifier: Apache-2.0

cmake_minimum_required(VERSION 3.20.0)
find_package(Zephyr REQUIRED HINTS $ENV{ZEPHYR_BASE})
project(wheel_source_test)

set(APP_SRC ${CMAKE_CURRENT_SOURCE_DIR}/../../app/src)

# The source under test, plus everything it needs from the application. The
# sensor is a fake driver defined by this test; the configuration and the CSCS
# publisher are stubs, because neither is what is being tested here.
target_sources(app PRIVATE
  src/main.c
  src/fake_accel.c
  src/stubs.c
  ${APP_SRC}/wheel_source_accel.c
  ${APP_SRC}/wheel_detector.c
  ${APP_SRC}/wheel_csc.c
  ${APP_SRC}/wheel_reconfig.c
)

target_include_directories(app PRIVATE
  src
  ${APP_SRC}
)
```

## prj.conf
```kconfig
# Copyright (c) 2026 Mateusz Żerebecki
# SPDX-License-Identifier: Apache-2.0

CONFIG_ZTEST=y
CONFIG_SENSOR=y
CONFIG_MAIN_STACK_SIZE=8192
CONFIG_LOG=n
CONFIG_CBPRINTF_FP_SUPPORT=y
```

## boards/native_sim_native_64.overlay
```dts
/*
 * Copyright (c) 2026 Mateusz Żerebecki
 * SPDX-License-Identifier: Apache-2.0
 *
 * A fake accelerometer the test drives directly, behind the alias
 * wheel_source_accel.c looks up.
 */

/ {
	aliases {
		accel0 = &fake_accel;
	};

	fake_accel: fake-accel {
		compatible = "vnd,fake-accel";
		status = "okay";
	};
};
```

## dts/bindings/sensor/vnd,fake-accel.yaml
```yaml
# Copyright (c) 2026 Mateusz Żerebecki
# SPDX-License-Identifier: Apache-2.0
description: Controllable accelerometer used by the wheel source integration test

# 'vnd' is Zephyr's registered stand-in vendor prefix for examples and tests.
compatible: "vnd,fake-accel"

include: base.yaml
```

## src/main.c
```c
/*
 * Copyright (c) 2026 Mateusz Żerebecki
 *
 * SPDX-License-Identifier: Apache-2.0
 *
 * Integration test for the accelerometer wheel source: the piece between the
 * sensor driver and the CSCS wire, which the unit tests on either side cannot
 * reach.
 *
 * The source's sampling thread is not started here (wheel_source_accel.c
 * omits K_THREAD_DEFINE under CONFIG_ZTEST); the test drives
 * wheel_source_accel_step() itself, so nothing depends on the kernel clock or
 * on how the scheduler happened to interleave.
 */

#include <errno.h>

#include <zephyr/device.h>
#include <zephyr/kernel.h>
#include <zephyr/sys/util.h>
#include <zephyr/ztest.h>

#include "fake_accel.h"
#include "stubs.h"
#include "wheel_config.h"
#include "wheel_source_accel.h"

/* Advanced by hand instead of by the kernel, so the cadence is deterministic. */
static uint64_t next_us;
static uint32_t period_us;

static void step(unsigned int times)
{
	for (unsigned int i = 0; i < times; i++) {
		wheel_source_accel_step(&next_us, &period_us);
	}
}

static void *suite_setup(void)
{
	zassert_ok(wheel_source_accel_init(), "the source refused to start");

	return NULL;
}

static void reset_harness(void)
{
	fake_accel_reset_counters();

	/*
	 * wheel_source_accel_init() re-initialises the CSC state and the
	 * reconfiguration gate, which are static and would otherwise carry over
	 * between tests: a later test would find the sensor already configured
	 * and see no attr_set() calls at all.
	 */
	zassert_ok(wheel_source_accel_init(), "the source refused to restart");
	fake_accel_fail_frequency(false);
	fake_accel_fail_full_scale(false);
	fake_accel_fail_fetch(0);
	fake_accel_report_no_data(false);
	fake_accel_set_sample(0.0f, 0.0f, 9.80665f);
	stub_publish_reset();
	wheel_source_accel_stats_reset();
	next_us = 0;
	period_us = 0;
}

static void before_each(void *fixture)
{
	ARG_UNUSED(fixture);

	reset_harness();
}

ZTEST(wheel_source, test_the_harness_is_wired_up)
{
	const struct device *accel = DEVICE_DT_GET(DT_ALIAS(accel0));

	zassert_true(device_is_ready(accel), "the fake accelerometer is not ready");
	zassert_not_null(wheel_config_get(), "the configuration stub is missing");
}

ZTEST(wheel_source, test_the_source_configures_the_sensor_before_measuring)
{
	reset_harness();

	step(1);

	zassert_equal(fake_accel_frequency_sets(), 1U,
		      "the source must push the ODR into the sensor");
	zassert_equal(fake_accel_full_scale_sets(), 1U,
		      "the source must push the full scale into the sensor");
}

/*
 * A bus error means the samples in between never arrived. The detector only
 * sees that time passed, so it has to be told or it interpolates across a hole
 * it cannot see.
 */
ZTEST(wheel_source, test_a_bus_error_is_reported_to_the_detector)
{
	struct wheel_source_stats stats;

	fake_accel_fail_fetch(-EIO);

	step(1);

	wheel_source_accel_stats(&stats);
	zassert_equal(stats.lost, 1U,
		      "the detector was not told about the lost samples");
	zassert_equal(stats.no_data, 0U,
		      "a bus error is not the same as 'no new sample yet'");
}

/*
 * -ENODATA at a polling rate equal to the ODR is the normal case. Telling the
 * detector would drop a phase that is still perfectly valid - which is why the
 * first version of the plan, proposing exactly that, was wrong.
 */
ZTEST(wheel_source, test_no_new_sample_yet_is_not_reported_as_loss)
{
	struct wheel_source_stats stats;

	fake_accel_report_no_data(true);

	step(3);

	wheel_source_accel_stats(&stats);
	zassert_equal(stats.no_data, 3U, "-ENODATA was not counted as normal");
	zassert_equal(stats.lost, 0U,
		      "-ENODATA must not be treated as a discontinuity");
	zassert_equal(stub_published_count(), 0U, "nothing to publish");
}

/*
 * A thread held off for longer than a sampling period leaves the deadline in
 * the past. Advancing it by one period keeps it there, and the following
 * passes fetch back to back - reading the same sample over and over - until it
 * catches up.
 */
ZTEST(wheel_source, test_a_stale_deadline_is_rebased_not_chased)
{
	uint64_t now;

	step(1); /* settles period_us from the configured ODR */

	/* Let the kernel clock move on, then drop the deadline far behind. */
	k_sleep(K_MSEC(50));
	next_us = 0;

	step(1);

	now = k_ticks_to_us_floor64(k_uptime_ticks());
	zassert_true(next_us > now,
		     "the deadline is still in the past (next=%llu, now=%llu), so "
		     "the following passes would fetch back to back",
		     next_us, now);
}

/*
 * The shell has a detector of its own for its own recording, so `wheel status`
 * would happily describe that one and never the detector that counts the wheel
 * - healthy-looking output for a wheel that is not being counted at all. These
 * counters are the only view of the production detector from outside the
 * sampling thread, and they are what the plan's hardware session reads to tell
 * "the calibration rejected the data" from "the calibration never started".
 *
 * Numbers here are deterministic, not sampled: the fake sensor is constant, so
 * the movement gate never opens and the still window closes exactly once.
 */
ZTEST(wheel_source, test_the_production_detectors_counters_are_visible)
{
	struct wheel_detector_stats st;
	struct wheel_detector_result last;

	zassert_true(wheel_source_accel_detector_stats(&st, &last),
		     "the source reports no detector after a successful init");

	wheel_source_accel_detector_stats_reset();
	zassert_true(wheel_source_accel_detector_stats(&st, &last), "...");
	zassert_equal(st.still_windows, 0U, "reset did not clear the counters");

	step(60);

	zassert_true(wheel_source_accel_detector_stats(&st, &last),
		     "the counters stopped being readable once sampling started");

	zassert_equal(st.still_windows, 1U,
		      "a constant sensor should close exactly one still window, "
		      "not %u", st.still_windows);
	zassert_equal(st.moving_samples, 0U,
		      "a still sensor was classified as moving %u times",
		      st.moving_samples);

	/*
	 * The gate must sit on its configured floor while the wheel is still.
	 * If it ever rises above the gravity circle - about 2 g - nothing can be
	 * moving again and the detector never leaves IDLE, which is the failure
	 * the replay found in one of the recordings. A still sensor is the case
	 * where that must be impossible.
	 */
	zassert_within(st.gate_last, 0.5f, 0.001f,
		       "the gate left its floor while the sensor was still: "
		       "%.3f m/s2", (double)st.gate_last);
	zassert_within(st.noise_last, 0.0f, 0.001f,
		       "a constant sensor produced %.3f m/s2 of noise",
		       (double)st.noise_last);
	zassert_equal(st.plane_attempts, 0U,
		      "a still wheel started a calibration");

	zassert_equal(last.state, WHEEL_STATE_IDLE, "the detector left IDLE");
	zassert_equal(last.revolutions, 0U, "a still wheel produced revolutions");
}

ZTEST_SUITE(wheel_source, NULL, suite_setup, before_each, NULL, NULL);
```

## src/fake_accel.c
```c
/*
 * Copyright (c) 2026 Mateusz Żerebecki
 *
 * SPDX-License-Identifier: Apache-2.0
 *
 * A controllable accelerometer for the wheel source integration test.
 *
 * The point is not to emulate the LIS2DH12 - the driver already has its own
 * emulator tests. It is to be able to say "the ODR took effect but the full
 * scale was refused", or "there is no new sample yet", and then watch what the
 * wheel source does with that.
 */

#define DT_DRV_COMPAT vnd_fake_accel

#include <errno.h>

#include <zephyr/device.h>
#include <zephyr/drivers/sensor.h>

#include "fake_accel.h"

static struct {
	bool fail_frequency;
	bool fail_full_scale;
	bool no_data;
	int fetch_err;
	float x;
	float y;
	float z;
	unsigned int attr_set_calls;
	unsigned int frequency_sets;
	unsigned int full_scale_sets;
} fake;

void fake_accel_fail_frequency(bool fail)
{
	fake.fail_frequency = fail;
}

void fake_accel_fail_full_scale(bool fail)
{
	fake.fail_full_scale = fail;
}

void fake_accel_set_sample(float x, float y, float z)
{
	fake.x = x;
	fake.y = y;
	fake.z = z;
}

void fake_accel_report_no_data(bool no_data)
{
	fake.no_data = no_data;
}

void fake_accel_fail_fetch(int err)
{
	fake.fetch_err = err;
}

unsigned int fake_accel_attr_set_calls(void)
{
	return fake.attr_set_calls;
}

unsigned int fake_accel_frequency_sets(void)
{
	return fake.frequency_sets;
}

unsigned int fake_accel_full_scale_sets(void)
{
	return fake.full_scale_sets;
}

void fake_accel_reset_counters(void)
{
	fake.attr_set_calls = 0;
	fake.frequency_sets = 0;
	fake.full_scale_sets = 0;
}

static int fake_init(const struct device *dev)
{
	ARG_UNUSED(dev);

	return 0;
}

static int fake_sample_fetch(const struct device *dev, enum sensor_channel chan)
{
	ARG_UNUSED(dev);

	if (chan != SENSOR_CHAN_ALL && chan != SENSOR_CHAN_ACCEL_XYZ) {
		return -ENOTSUP;
	}
	if (fake.fetch_err != 0) {
		return fake.fetch_err;
	}
	if (fake.no_data) {
		return -ENODATA;
	}

	return 0;
}

static void set_value(struct sensor_value *val, float value)
{
	val->val1 = (int32_t)value;
	val->val2 = (int32_t)((value - (float)val->val1) * 1000000.0f);
}

static int fake_channel_get(const struct device *dev, enum sensor_channel chan,
			    struct sensor_value *val)
{
	ARG_UNUSED(dev);

	if (chan != SENSOR_CHAN_ACCEL_XYZ) {
		return -ENOTSUP;
	}

	set_value(&val[0], fake.x);
	set_value(&val[1], fake.y);
	set_value(&val[2], fake.z);

	return 0;
}

static int fake_attr_set(const struct device *dev, enum sensor_channel chan,
			 enum sensor_attribute attr,
			 const struct sensor_value *val)
{
	ARG_UNUSED(dev);
	ARG_UNUSED(chan);
	ARG_UNUSED(val);

	fake.attr_set_calls++;

	switch (attr) {
	case SENSOR_ATTR_SAMPLING_FREQUENCY:
		fake.frequency_sets++;
		return fake.fail_frequency ? -EIO : 0;
	case SENSOR_ATTR_FULL_SCALE:
		fake.full_scale_sets++;
		return fake.fail_full_scale ? -EIO : 0;
	default:
		return -ENOTSUP;
	}
}

/* DEVICE_API() is what puts the struct in the sensor API section the sensor
 * subsystem asserts against; a plain const struct would be rejected at
 * runtime. */
static DEVICE_API(sensor, fake_api) = {
	.sample_fetch = fake_sample_fetch,
	.channel_get = fake_channel_get,
	.attr_set = fake_attr_set,
};

#define FAKE_ACCEL_INST(inst)						\
	SENSOR_DEVICE_DT_INST_DEFINE(inst, fake_init, NULL, NULL, NULL,	\
				     POST_KERNEL,			\
				     CONFIG_SENSOR_INIT_PRIORITY,	\
				     &fake_api);

DT_INST_FOREACH_STATUS_OKAY(FAKE_ACCEL_INST)
```

## src/fake_accel.h
```c
/*
 * Copyright (c) 2026 Mateusz Żerebecki
 *
 * SPDX-License-Identifier: Apache-2.0
 */

#ifndef SPEED_METER_TEST_FAKE_ACCEL_H_
#define SPEED_METER_TEST_FAKE_ACCEL_H_

#include <stdbool.h>

/* Make attr_set() reject one half of a configuration, so the test can build
 * the partial success the fail-closed gate exists for. */
void fake_accel_fail_frequency(bool fail);
void fake_accel_fail_full_scale(bool fail);

/* What the driver will return from the next sample_fetch(). */
void fake_accel_set_sample(float x, float y, float z);
void fake_accel_report_no_data(bool no_data);
void fake_accel_fail_fetch(int err);

/* What the wheel source asked for. */
unsigned int fake_accel_attr_set_calls(void);
unsigned int fake_accel_frequency_sets(void);
unsigned int fake_accel_full_scale_sets(void);
void fake_accel_reset_counters(void);

#endif /* SPEED_METER_TEST_FAKE_ACCEL_H_ */
```

## src/stubs.c
```c
/*
 * Copyright (c) 2026 Mateusz Żerebecki
 *
 * SPDX-License-Identifier: Apache-2.0
 *
 * The wheel source's collaborators, reduced to what the test observes: the
 * configuration it reads, and the measurements it publishes.
 *
 * The real wheel_config.c persists through NVS and the real csc.c needs
 * Bluetooth; neither is what this test is about.
 */

#include "stubs.h"

#include "csc.h"
#include "wheel_config.h"

static struct wheel_config cfg = {
	.axis_a = 3, /* plane detected automatically */
	.circ_mm = 2100,
	.odr_hz = 100,
	.range_g = 16,
	.rpm_max = 1200,
	.rpm_min = 12,
};

const struct wheel_config *wheel_config_get(void)
{
	return &cfg;
}

void stub_config_set_odr(uint16_t hz)
{
	cfg.odr_hz = hz;
}

void stub_config_set_range(uint8_t g)
{
	cfg.range_g = g;
}

void stub_config_set_circumference(uint16_t mm)
{
	cfg.circ_mm = mm;
}

void stub_config_set_rpm_max(uint16_t rpm)
{
	cfg.rpm_max = rpm;
}

/* Published measurements, in order. */
#define PUBLISHED_MAX 256U

static struct {
	uint32_t revolutions;
	uint16_t event_time;
} published[PUBLISHED_MAX];
static unsigned int published_count;

void csc_publish_wheel(uint32_t cumulative_revolutions,
		       uint16_t last_event_time_1024)
{
	if (published_count < PUBLISHED_MAX) {
		published[published_count].revolutions = cumulative_revolutions;
		published[published_count].event_time = last_event_time_1024;
	}
	published_count++;
}

unsigned int stub_published_count(void)
{
	return published_count;
}

uint32_t stub_published_revolutions(unsigned int index)
{
	return index < published_count ? published[index].revolutions : 0U;
}

uint16_t stub_published_event_time(unsigned int index)
{
	return index < published_count ? published[index].event_time : 0U;
}

void stub_publish_reset(void)
{
	published_count = 0;
}
```

## src/stubs.h
```c
/*
 * Copyright (c) 2026 Mateusz Żerebecki
 *
 * SPDX-License-Identifier: Apache-2.0
 */

#ifndef SPEED_METER_TEST_STUBS_H_
#define SPEED_METER_TEST_STUBS_H_

#include <stdint.h>

/* The configuration the source under test reads. */
void stub_config_set_odr(uint16_t hz);
void stub_config_set_range(uint8_t g);
void stub_config_set_circumference(uint16_t mm);
void stub_config_set_rpm_max(uint16_t rpm);

/* What the source published over CSCS. */
unsigned int stub_published_count(void);
uint32_t stub_published_revolutions(unsigned int index);
uint16_t stub_published_event_time(unsigned int index);
void stub_publish_reset(void);

#endif /* SPEED_METER_TEST_STUBS_H_ */
```
